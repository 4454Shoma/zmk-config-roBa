#include "roBa.dtsi"

/* 既存のスキャンピン定義（そのままでOK） */
&kscan0 {
    col-gpios = <&xiao_d 10 GPIO_ACTIVE_HIGH>,
                <&xiao_d 9  GPIO_ACTIVE_HIGH>,
                <&xiao_d 8  GPIO_ACTIVE_HIGH>,
                <&xiao_d 7  GPIO_ACTIVE_HIGH>,
                <&gpio0 10  GPIO_ACTIVE_HIGH>,
                <&gpio0 9   GPIO_ACTIVE_HIGH>;
};

/* 左エンコーダを有効化（← このブロックは ; で終わる） */
&left_encoder {
    status = "okay";
};

/* ZMKのセンサー束ねを“左だけ”に上書き（← これも ; で終わる） */
&sensors {
    sensors = <&left_encoder>;
    /* デテント数に合わせる。EC11なら 15 か 24 が無難 */
    triggers-per-rotation = <15>;
};
